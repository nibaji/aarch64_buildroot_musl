## defconfig
```kconfig
BR2_aarch64=y
BR2_cortex_a73_a53=y
BR2_CCACHE=y
BR2_OPTIMIZE_3=y
BR2_SSP_ALL=y
BR2_RELRO_FULL=y
BR2_TOOLCHAIN_BUILDROOT_VENDOR="nibaji"
BR2_TOOLCHAIN_BUILDROOT_MUSL=y
BR2_KERNEL_HEADERS_4_4=y
BR2_BINUTILS_VERSION_2_31_X=y
BR2_GCC_VERSION_8_X=y
BR2_EXTRA_GCC_CONFIG_OPTIONS="march=armv8-a+crc mcpu=kryo mtune=a73.a53"
BR2_TOOLCHAIN_BUILDROOT_CXX=y
BR2_TOOLCHAIN_BUILDROOT_FORTRAN=y
BR2_GCC_ENABLE_LTO=y
BR2_GCC_ENABLE_OPENMP=y
BR2_GCC_ENABLE_GRAPHITE=y
BR2_PACKAGE_HOST_GDB=y
BR2_PACKAGE_HOST_GDB_TUI=y
BR2_PACKAGE_HOST_GDB_PYTHON=y
BR2_GDB_VERSION_8_1=y
BR2_TARGET_OPTIMIZATION="-O3"
BR2_TARGET_GENERIC_HOSTNAME="Insignite"
```
